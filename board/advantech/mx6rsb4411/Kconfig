## configs/mx6cuboxi_nt_defconfig
```kconfig
CONFIG_ARCH_MX6=y
CONFIG_ARM=y
CONFIG_SYS_TEXT_BASE=0x17800000
CONFIG_TARGET_MX6CUBOXI=y
CONFIG_DEFAULT_DEVICE_TREE="imx6qdl-mx6cuboxi"
CONFIG_OF_CONTROL=y
CONFIG_FORBID_SHA1=y
CONFIG_FIT=y
CONFIG_FIT_VERBOSE=y
CONFIG_FIT_SIGNATURE=y
CONFIG_SPL_OPTEE_BOOT=y
CONFIG_BOARD_EARLY_INIT_F=y
CONFIG_BOOTCOMMAND="globalpage init 0x10817000; globalpage add ethaddr; fatload mmc 0:2 0x80A20000 /uefi.fit; bootm 0x80A20000"
CONFIG_BOOTDELAY=-2
CONFIG_IMX_PERSIST_INIT=y
CONFIG_EFI_LOADER=n
CONFIG_CMD_BOOTD=n
CONFIG_CMD_BOOTM=y
CONFIG_CMD_CACHE=y
CONFIG_CMD_FAT=y
CONFIG_CMD_GPIO=y
CONFIG_CMD_HDMIDETECT=y
CONFIG_CMD_I2C=n
CONFIG_CMD_MMC=y
CONFIG_CMD_SATA=y
CONFIG_CMD_PART=y
CONFIG_CMD_SPL=n
CONFIG_CMD_USB=y
CONFIG_CYRES=y
CONFIG_CMD_GLOBAL_PAGE=y
CONFIG_DISTRO_DEFAULTS=y
CONFIG_DM=y
CONFIG_DWC_AHSATA=y
CONFIG_DM_THERMAL=y
CONFIG_HUSH_PARSER=y
CONFIG_CONS_INDEX=1
CONFIG_PCI=n
CONFIG_FSL_ESDHC=y
CONFIG_PHYLIB=y
CONFIG_SECURE_BOOT=y
CONFIG_SPL_BOARD_PROVISION=y
CONFIG_SPL_BOARD_PROVISION_FUSES=n
CONFIG_SPL=y
CONFIG_SPL_FSL_CAAM=y
CONFIG_SPL_LOAD_FIT=y
CONFIG_SPL_FIT_SIGNATURE_STRICT=y
CONFIG_SPL_HASH_SUPPORT=y
CONFIG_SPL_ECC=y
CONFIG_USE_TINY_SHA256=y
CONFIG_SPL_OF_CONTROL=y
CONFIG_SPL_LEGACY_IMAGE_SUPPORT=n
CONFIG_SPL_OF_LIBFDT=y
CONFIG_SPL_DM=n
CONFIG_SPL_SYS_MALLOC_SIMPLE=y
CONFIG_SPL_CRYPTO_SUPPORT=y
CONFIG_SPL_ENABLE_CACHES=y
CONFIG_SPL_EXT_SUPPORT=n
CONFIG_SPL_GPIO_SUPPORT=y
CONFIG_SPL_I2C_SUPPORT=n
CONFIG_SPL_LIBCOMMON_SUPPORT=y
CONFIG_SPL_LIBDISK_SUPPORT=n
CONFIG_SPL_LIBGENERIC_SUPPORT=y
CONFIG_SPL_MMC_SUPPORT=y
CONFIG_SPL_SERIAL_SUPPORT=y
CONFIG_SPL_SPI_SUPPORT=n
CONFIG_SPL_USE_ARCH_MEMCPY=n
CONFIG_SPL_WATCHDOG_SUPPORT=y
CONFIG_SPL_LDSCRIPT="arch/arm/cpu/u-boot-spl.lds"
CONFIG_SYS_EXTRA_OPTIONS="IMX_CONFIG=arch/arm/mach-imx/spl_sd.cfg"
CONFIG_SYS_L2CACHE_OFF=y
CONFIG_SYS_MALLOC_F_LEN=0x800
CONFIG_ENV_VARS_UBOOT_RUNTIME_CONFIG=y
CONFIG_MII=y
CONFIG_USB_KEYBOARD=y
CONFIG_USB_STORAGE=y
CONFIG_USB=y
CONFIG_USE_TINY_PRINTF=y
CONFIG_VIDEO=y
CONFIG_OF_LIBFDT=y
```

## configs/mx6sabrelite_nt_defconfig
```kconfig
CONFIG_ARCH_MX6=y
CONFIG_ARM=y
CONFIG_NR_DRAM_BANKS=y
CONFIG_BAUDRATE=115200
CONFIG_BOOTCOMMAND="globalpage init 0x10817000; globalpage add ethaddr; fatload mmc 0:2 0x80A20000 /uefi.fit; bootm 0x80A20000"
CONFIG_BOOTDELAY=-2
# CONFIG_CI_UDC=y
CONFIG_CMD_BMP=y
CONFIG_CMD_BOOTZ=y
CONFIG_CMD_CACHE=y
CONFIG_CMD_CYREP=n
CONFIG_CMD_DHCP=y
CONFIG_CMD_FAT=y
CONFIG_CMD_FS_GENERIC=y
CONFIG_CMD_GLOBAL_PAGE=y
CONFIG_CMD_GPIO=y
CONFIG_CMD_HDMIDETECT=y
CONFIG_CMD_I2C=y
CONFIG_CMD_MMC=y
CONFIG_CMD_PART=y
CONFIG_CMD_PCI=y
CONFIG_CMD_PING=y
CONFIG_CMD_SATA=y
CONFIG_CMD_SPL=n
CONFIG_CMD_SF=y
CONFIG_CMD_USB=y
CONFIG_CYREP=n
CONFIG_DEFAULT_DEVICE_TREE="imx6qdl-sabrelite"
CONFIG_DISTRO_DEFAULTS=y
CONFIG_DWC_AHSATA=y
CONFIG_EFI_LOADER=n
CONFIG_FIT=y
CONFIG_FIT_VERBOSE=y
CONFIG_FSL_ESDHC=y
CONFIG_HUSH_PARSER=y
CONFIG_IMX_PERSIST_INIT=y
CONFIG_NETDEVICES=y
CONFIG_OF_CONTROL=y
CONFIG_OF_LIBFDT=y
CONFIG_SECURE_BOOT=y
CONFIG_SPL=y
CONFIG_SPL_CRYPTO_SUPPORT=y
CONFIG_SPL_DM=n
CONFIG_SPL_ENABLE_CACHES=y
CONFIG_SPL_FIT=y
CONFIG_SPL_GPIO_SUPPORT=y
CONFIG_SPL_I2C_SUPPORT=y
CONFIG_SPL_LDSCRIPT="arch/arm/cpu/u-boot-spl.lds"
CONFIG_SPL_LEGACY_IMAGE_SUPPORT=n
CONFIG_SPL_LIBCOMMON_SUPPORT=y
CONFIG_SPL_LIBDISK_SUPPORT=n
CONFIG_SPL_LIBGENERIC_SUPPORT=y
CONFIG_SPL_LOAD_FIT=y
CONFIG_SPL_MMC_SUPPORT=y
CONFIG_SPL_OF_LIBFDT=y
CONFIG_SPL_OPTEE_BOOT=y
CONFIG_SPL_SERIAL_SUPPORT=y
CONFIG_SPL_SPI_FLASH_SUPPORT=y
CONFIG_SPL_SYS_MALLOC_SIMPLE=y
CONFIG_SPL_USE_ARCH_MEMCPY=n
CONFIG_SPL_WATCHDOG_SUPPORT=y
CONFIG_STORE_MAC_IN_GLOBAL=y
#CONFIG_SYS_EXTRA_OPTIONS="IMX_CONFIG=arch/arm/mach-imx/spl_sd.cfg"
CONFIG_SYS_EXTRA_OPTIONS="IMX_CONFIG=board/freescale/mx6sabrelite/spl_spi.cfg"
CONFIG_SYS_CONSOLE_OVERWRITE_ROUTINE=y
CONFIG_SYS_L2CACHE_OFF=y
CONFIG_SYS_MALLOC_F_LEN=0x800
CONFIG_SYS_TEXT_BASE=0x17800000
CONFIG_SYS_USB_EVENT_POLL_VIA_CONTROL_EP=y
CONFIG_TARGET_MX6SABRELITE=y
CONFIG_USB=y
CONFIG_USB_GADGET=y
CONFIG_USE_TINY_PRINTF=y
CONFIG_VIDEO=y
```

## configs/mx6sxsabresd_nt_defconfig
```kconfig
CONFIG_ARCH_MX6=y
CONFIG_ARM=y
CONFIG_SYS_TEXT_BASE=0x87800000
CONFIG_TARGET_MX6SXSABRESD=y
CONFIG_DEFAULT_DEVICE_TREE="imx6sx-sdb"
CONFIG_NXP_BOARD_REVISION=y
CONFIG_OF_CONTROL=y
CONFIG_FIT=y
CONFIG_FIT_VERBOSE=y
CONFIG_FIT_SIGNATURE=y
CONFIG_SPL_OPTEE_BOOT=y
CONFIG_USE_BOOTCOMMAND=y
CONFIG_BOARD_EARLY_INIT_F=y
CONFIG_BOOTCOMMAND="globalpage init 0x82003000; globalpage add ethaddr; globalpage add eth1addr; fatload mmc 3:2 0x80A20000 /uefi.fit; bootm 0x80A20000"
CONFIG_BOOTDELAY=-2
CONFIG_IMX_PERSIST_INIT=y
CONFIG_EFI_LOADER=n
CONFIG_CMD_BOOTD=n
CONFIG_CMD_BOOTM=y
CONFIG_CMD_CACHE=y
CONFIG_CMD_FAT=y
CONFIG_CMD_GPIO=n
CONFIG_CMD_I2C=y
CONFIG_CMD_MMC=y
CONFIG_CMD_PART=y
CONFIG_CMD_PCI=n
CONFIG_CMD_SPL=n
CONFIG_CMD_USB=y
CONFIG_CYRES=y
CONFIG_CMD_GLOBAL_PAGE=y
CONFIG_HUSH_PARSER=y
CONFIG_CONS_INDEX=1
CONFIG_DM_GPIO=y
CONFIG_DM_I2C=y
CONFIG_DM_MMC=y
CONFIG_PHYLIB=y
CONFIG_SECURE_BOOT=y
CONFIG_FSL_ESDHC=y
CONFIG_SPI_FLASH=n
CONFIG_SPI_FLASH_STMICRO=n
CONFIG_SPL=y
CONFIG_SPL_FSL_CAAM=y
CONFIG_SPL_FIT=y
CONFIG_SPL_LOAD_FIT=y
CONFIG_SPL_FIT_SIGNATURE_STRICT=y
CONFIG_SPL_HASH_SUPPORT=y
CONFIG_SPL_ECC=y
CONFIG_USE_TINY_SHA256=y
CONFIG_SPL_OF_CONTROL=y
CONFIG_SPL_LEGACY_IMAGE_SUPPORT=n
CONFIG_SPL_OF_LIBFDT=y
CONFIG_SPL_DM=n
CONFIG_SPL_SYS_MALLOC_SIMPLE=y
CONFIG_SPL_CRYPTO_SUPPORT=y
CONFIG_SPL_ENABLE_CACHES=y
CONFIG_SPL_GPIO_SUPPORT=y
CONFIG_SPL_LIBCOMMON_SUPPORT=y
CONFIG_SPL_LIBGENERIC_SUPPORT=y
CONFIG_SPL_MMC_SUPPORT=y
CONFIG_SPL_SERIAL_SUPPORT=y
CONFIG_SPL_USE_ARCH_MEMCPY=n
CONFIG_SPL_WATCHDOG_SUPPORT=y
CONFIG_SPL_LDSCRIPT="arch/arm/cpu/u-boot-spl.lds"
CONFIG_SYS_DCACHE_OFF=y
CONFIG_SYS_EXTRA_OPTIONS="IMX_CONFIG=arch/arm/mach-imx/spl_sd.cfg"
CONFIG_SYS_ICACHE_OFF=n
CONFIG_SYS_L2CACHE_OFF=y
CONFIG_SYS_MALLOC_F_LEN=0x800
CONFIG_ENV_VARS_UBOOT_RUNTIME_CONFIG=y
CONFIG_MII=y
CONFIG_USB=y
CONFIG_USE_TINY_PRINTF=y
CONFIG_VIDEO=y
CONFIG_OF_LIBFDT=y
CONFIG_PINCTRL=y
CONFIG_PINCTRL_IMX6=y
CONFIG_DM_PMIC=y
CONFIG_DM_PMIC_PFUZE100=y
CONFIG_DM_REGULATOR=y
CONFIG_DM_REGULATOR_PFUZE100=y
CONFIG_DM_REGULATOR_FIXED=y
CONFIG_DM_REGULATOR_GPIO=y
```

## configs/mx6vab820_nt_defconfig
```kconfig
CONFIG_ARCH_MX6=y
CONFIG_ARM=y
CONFIG_SYS_TEXT_BASE=0x17800000
CONFIG_TARGET_MX6VAB820=y
CONFIG_NR_DRAM_BANKS=1
CONFIG_DEFAULT_DEVICE_TREE="imx6qdl-vab820"
CONFIG_OF_CONTROL=y
CONFIG_FIT=y
CONFIG_FIT_VERBOSE=y
CONFIG_SPL_OPTEE_BOOT=y
CONFIG_BAUDRATE=115200
CONFIG_USE_BOOTCOMMAND=y
CONFIG_BOOTCOMMAND="run bootcmd_uefi"
CONFIG_BOOTDELAY=-2
CONFIG_IMX_PERSIST_INIT=y
CONFIG_EFI_LOADER=n
CONFIG_CMD_BOOTD=n
CONFIG_CMD_BOOTM=y
CONFIG_CMD_CACHE=y
CONFIG_CMD_CYREP=n
CONFIG_CMD_FAT=y
# CONFIG_CMD_FLASH is not set
CONFIG_CMD_GPIO=n
CONFIG_CMD_I2C=y
# CONFIG_CMD_IMLS is not set
CONFIG_CMD_MMC=y
CONFIG_CMD_PART=y
CONFIG_CMD_PCI=y
CONFIG_CMD_SPL=n
CONFIG_CMD_SF=y
CONFIG_CMD_USB=y
CONFIG_CMD_GLOBAL_PAGE=y
CONFIG_CYREP=n
CONFIG_HUSH_PARSER=y
CONFIG_SPI=y
CONFIG_MXC_SPI=y
CONFIG_MXC_UART3=n
CONFIG_CONS_INDEX=1
CONFIG_SECURE_BOOT=y
CONFIG_FSL_ESDHC=y
CONFIG_SPI_FLASH=y
CONFIG_SPI_FLASH_STMICRO=y
CONFIG_SPI_FLASH_SST=y
CONFIG_SPI_FLASH_WINBOND=y
CONFIG_SPI_FLASH_MACRONIX=y
CONFIG_SPL=y
CONFIG_SPL_FIT=y
CONFIG_SPL_LOAD_FIT=y
CONFIG_SPL_LEGACY_IMAGE_SUPPORT=n
CONFIG_SPL_OF_LIBFDT=y
CONFIG_SPL_DM=n
CONFIG_SPL_SYS_MALLOC_SIMPLE=y
CONFIG_SPL_CRYPTO_SUPPORT=y
CONFIG_SPL_ENABLE_CACHES=y
CONFIG_SPL_GPIO_SUPPORT=y
CONFIG_SPL_LIBCOMMON_SUPPORT=y
CONFIG_SPL_LIBGENERIC_SUPPORT=y
CONFIG_SPL_MMC_SUPPORT=y
CONFIG_SPL_SERIAL_SUPPORT=y
CONFIG_SPL_SPI_FLASH_SUPPORT=y
CONFIG_SPL_USE_ARCH_MEMCPY=n
CONFIG_SPL_WATCHDOG_SUPPORT=y
CONFIG_SPL_LDSCRIPT="arch/arm/cpu/u-boot-spl.lds"
CONFIG_SYS_DCACHE_OFF=n
CONFIG_SYS_EXTRA_OPTIONS="IMX_CONFIG=arch/arm/mach-imx/spl_sd.cfg"
CONFIG_SYS_ICACHE_OFF=n
CONFIG_SYS_L2CACHE_OFF=y
CONFIG_SYS_MALLOC_F_LEN=0x800
CONFIG_ENV_VARS_UBOOT_RUNTIME_CONFIG=y
CONFIG_USB=y
CONFIG_USE_TINY_PRINTF=y
CONFIG_VIDEO=y
CONFIG_OF_LIBFDT=y
```

## configs/mx7dsabresd_nt_defconfig
```kconfig
CONFIG_ARM=y
CONFIG_ARCH_MX7=y
CONFIG_SYS_THUMB_BUILD=y
CONFIG_SYS_TEXT_BASE=0x87800000
CONFIG_TARGET_MX7DSABRESD=y
CONFIG_DEFAULT_DEVICE_TREE="imx7d-sdb"
CONFIG_OF_CONTROL=y
CONFIG_FORBID_SHA1=y
CONFIG_FIT=y
CONFIG_FIT_SIGNATURE=y
CONFIG_FIT_VERBOSE=y
CONFIG_CYRES=y
CONFIG_SPL_OPTEE_BOOT=y
CONFIG_SPL_FSL_CAAM=y
CONFIG_SPL_CRYPTO_SUPPORT=y
CONFIG_ARMV7_BOOT_SEC_DEFAULT=y
CONFIG_ARMV7_NONSEC=n
# CONFIG_ARMV7_VIRT is not set
CONFIG_BAUDRATE=115200
CONFIG_USE_BOOTCOMMAND=y
CONFIG_BOOTCOMMAND="globalpage init 0x82003000; globalpage add ethaddr; fatload mmc 0:2 0x80A20000 /uefi.fit; bootm 0x80A20000"
CONFIG_BOOTDELAY=-2
CONFIG_IMX_PERSIST_INIT=y
# CONFIG_CMD_BMODE is not set
# CONFIG_CMD_BOOTD is not set
CONFIG_CMD_BOOTM=y
CONFIG_CMD_BOOTZ=n
# CONFIG_CMD_IMI is not set
# CONFIG_CMD_XIMG is not set
# CONFIG_CMD_EXPORTENV is not set
# CONFIG_CMD_IMPORTENV is not set
CONFIG_CMD_GPIO=y
CONFIG_CMD_I2C=y
CONFIG_CMD_MMC=y
CONFIG_CMD_USB=y
CONFIG_CMD_BMP=y
CONFIG_CMD_CACHE=y
CONFIG_CMD_PMIC=y
CONFIG_CMD_REGULATOR=y
CONFIG_CMD_FAT=y
CONFIG_CMD_PART=y
CONFIG_CMD_FS_GENERIC=y
CONFIG_CMD_SF=y
CONFIG_CMD_GLOBAL_PAGE=y
# CONFIG_CONSOLE_MUX is not set
CONFIG_SYS_CONSOLE_IS_IN_ENV=y
CONFIG_DEBUG_UART_MXC=y
CONFIG_DEBUG_UART_CLOCK=24000000
CONFIG_DEBUG_UART_BASE=0x30860000
CONFIG_SPI=y
CONFIG_DM_74X164=y
CONFIG_DM_GPIO=y
CONFIG_DM_I2C=y
CONFIG_DM_MMC=y
CONFIG_DM_PMIC_PFUZE100=y
CONFIG_DM_PMIC=y
CONFIG_DM_REGULATOR_FIXED=y
CONFIG_DM_REGULATOR_GPIO=y
CONFIG_DM_REGULATOR_PFUZE100=y
CONFIG_DM_REGULATOR=y
CONFIG_DM_SERIAL=n
CONFIG_DM_SPI=y
CONFIG_DM_USB=y
CONFIG_ERRNO_STR=y
CONFIG_HUSH_PARSER=y
CONFIG_IMX_BOOTAUX=y
CONFIG_IMX_RDC=y
CONFIG_MXC_USB_OTG_HACTIVE=y
CONFIG_PHYLIB=y
CONFIG_MII=y
CONFIG_PINCTRL_IMX7=y
CONFIG_PINCTRL=y
CONFIG_SECURE_BOOT=y
CONFIG_SPL_SYS_MALLOC_SIMPLE=y
CONFIG_SOFT_SPI=y
CONFIG_FSL_ESDHC=y
CONFIG_SPI_FLASH_EON=y
CONFIG_SPI_FLASH=y
CONFIG_EFI_LOADER=n
CONFIG_SPL=y
CONFIG_SPL_LOAD_FIT=y
CONFIG_SPL_LEGACY_IMAGE_SUPPORT=n
CONFIG_SPL_DM=n
CONFIG_SPL_FIT=y
CONFIG_SPL_FIT_SIGNATURE_STRICT=y
CONFIG_SPL_HASH_SUPPORT=y
CONFIG_SPL_ECC=y
CONFIG_USE_TINY_SHA256=y
CONFIG_SPL_OF_CONTROL=y
CONFIG_SPL_OF_LIBFDT=y
CONFIG_SPL_DM_SERIAL=n
CONFIG_SPL_GPIO_SUPPORT=y
CONFIG_SPL_LIBCOMMON_SUPPORT=y
CONFIG_SPL_LIBGENERIC_SUPPORT=y
CONFIG_SPL_MMC_SUPPORT=y
CONFIG_SPL_SERIAL_SUPPORT=y
CONFIG_USE_TINY_PRINTF=y
CONFIG_SPL_USE_ARCH_MEMCPY=n
CONFIG_SPL_WATCHDOG_SUPPORT=y
CONFIG_ENV_IS_IN_MMC=n
CONFIG_SYS_EXTRA_OPTIONS="IMX_CONFIG=board/freescale/mx7dsabresd/imximage.cfg"
CONFIG_SYS_MALLOC_F_LEN=0x0800
CONFIG_SYS_MMCSD_RAW_MODE_U_BOOT_SECTOR=0x8A
CONFIG_SYS_MMCSD_RAW_MODE_U_BOOT_USE_SECTOR=y
CONFIG_USB_FUNCTION_MASS_STORAGE=y
CONFIG_USB_EHCI_HCD=y
CONFIG_USB_KEYBOARD=y
CONFIG_USB_STORAGE=y
CONFIG_USB=y
CONFIG_VIDEO_MXS=y
CONFIG_VIDEO=y
CONFIG_OF_LIBFDT=y
```

## configs/udoo_neo_nt_defconfig
```kconfig
CONFIG_ARCH_MX6=y
CONFIG_ARM=y
CONFIG_SYS_TEXT_BASE=0x87800000
CONFIG_TARGET_UDOO_NEO=y
CONFIG_DEFAULT_DEVICE_TREE="imx6sx-udoo-neo"
CONFIG_OF_CONTROL=y
CONFIG_FIT=y
CONFIG_FIT_VERBOSE=y
CONFIG_SPL_OPTEE_BOOT=y
CONFIG_BOARD_EARLY_INIT_F=y
CONFIG_USE_BOOTCOMMAND=y
CONFIG_BOOTCOMMAND="fatload mmc 0:2 0x80A20000 /uefi.fit; bootm 0x80A20000"
CONFIG_BOOTDELAY=-2
CONFIG_EFI_LOADER=n
CONFIG_CMD_BOOTD=n
CONFIG_CMD_BOOTM=y
CONFIG_CMD_CACHE=y
CONFIG_CMD_FAT=y
CONFIG_CMD_GPIO=y
CONFIG_CMD_I2C=n
CONFIG_CMD_MMC=y
CONFIG_CMD_PART=y
CONFIG_CMD_SPL=n
CONFIG_DISTRO_DEFAULTS=y
CONFIG_ENV_IS_IN_MMC=n
CONFIG_HUSH_PARSER=y
CONFIG_PCI=n
CONFIG_FSL_ESDHC=y
CONFIG_PHYLIB=y
CONFIG_SECURE_BOOT=y
CONFIG_SPL=y
CONFIG_SPL_FIT=y
CONFIG_SPL_LOAD_FIT=y
CONFIG_SPL_LEGACY_IMAGE_SUPPORT=n
CONFIG_SPL_OF_LIBFDT=y
CONFIG_SPL_SYS_MALLOC_SIMPLE=y
CONFIG_SPL_CRYPTO_SUPPORT=y
CONFIG_SPL_EXT_SUPPORT=n
CONFIG_SPL_GPIO_SUPPORT=y
CONFIG_SPL_I2C_SUPPORT=n
CONFIG_SPL_LIBCOMMON_SUPPORT=y
CONFIG_SPL_LIBDISK_SUPPORT=n
CONFIG_SPL_LIBGENERIC_SUPPORT=y
CONFIG_SPL_MMC_SUPPORT=y
CONFIG_SPL_SERIAL_SUPPORT=y
CONFIG_SPL_SPI_SUPPORT=n
CONFIG_SPL_USE_ARCH_MEMCPY=n
CONFIG_SPL_WATCHDOG_SUPPORT=y
CONFIG_SPL_LDSCRIPT="arch/arm/cpu/u-boot-spl.lds"
CONFIG_SYS_EXTRA_OPTIONS="IMX_CONFIG=arch/arm/mach-imx/spl_sd.cfg"
CONFIG_SYS_L2CACHE_OFF=y
CONFIG_SYS_MALLOC_F_LEN=0x800
CONFIG_USE_TINY_PRINTF=y
CONFIG_PHY_MICREL=y
CONFIG_MII=y
CONFIG_OF_LIBFDT=y
```

## lib/cyres/Kconfig
```kconfig
#
# For a description of the syntax of this configuration file,
# see the file Documentation/kbuild/kconfig-language.txt in the
# Linux kernel source tree.
#

config CYRES
	bool
	prompt "Enable CyRes"
	default n
	help
	  Enable support for the Cyres library.
	  Cyres provides a tiny ECC and SHA256 software implementation.
	  Cyres also combines a device-unique secret with a measurement
	  of the next boot stage to create a certificate chain that is unique
	  to the device and version of firmware running on the device.
```

## lib/ecc/Kconfig
```kconfig
config ECC
	bool "Use ECC Library"
	select CONFIG_CYRES
	help
	  ECC support. This enables the ECC algorithm used for FIT image
	  verification in U-Boot.
	  See doc/uImage.FIT/signature.txt for more details.
	  The P-256 algorithm in ECC is implemented using CyRes crypt.
	  The signing part is build into mkimage regardless of this
	  option.

config SPL_ECC
	bool "Use ECC Library within SPL"
	select ECC
```
