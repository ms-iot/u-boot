## board/advantech/mx6rsb4411/Kconfig
```kconfig
if TARGET_MX6RSB4411A1

config SYS_BOARD
	default "mx6rsb4411"

config SYS_VENDOR
	default "advantech"

config SYS_CONFIG_NAME
	default "mx6rsb4411"

endif
```

## board/freescale/imx6ull_14x14_evk/Kconfig
```kconfig
if TARGET_IMX6ULL_14X14_EVK

config SYS_BOARD
	default "imx6ull_14x14_evk"

config SYS_VENDOR
	default "freescale"

config SYS_CONFIG_NAME
	default "imx6ull_14x14_evk"

endif
```

## board/freescale/ls1012afrdm/Kconfig
```kconfig
if TARGET_LS1012AFRDM

config SYS_BOARD
	default "ls1012afrdm"

config SYS_VENDOR
	default "freescale"

config SYS_SOC
	default "fsl-layerscape"

config SYS_CONFIG_NAME
	default "ls1012afrdm"

if FSL_PFE
config SYS_LS_PFE_FW_ADDR
	hex "Flash address of PFE firmware"
	default 0x40a00000
endif

source "board/freescale/common/Kconfig"

endif
```

## board/freescale/mx6sabrelite/Kconfig
```kconfig
if TARGET_MX6SABRELITE

config SYS_BOARD
	default "mx6sabrelite"

config SYS_VENDOR
	default "freescale"

config SYS_CONFIG_NAME
	default "mx6sabrelite"

endif
```

## board/scalys/grapeboard/Kconfig
```kconfig
if TARGET_GRAPEBOARD

config SYS_BOARD
	default "grapeboard"
	
config SYS_VENDOR
	default "scalys"
	
config SYS_SOC
	default "fsl-layerscape"

config SYS_CONFIG_NAME
	default "grapeboard"

config SYS_LS_PPA_FW_ADDR
	hex "PPA Firmware Addr"
	default 0x40280000
	
if FSL_PFE

config BOARD_SPECIFIC_OPTIONS # dummy
	def_bool y
	select PHYLIB
	imply CONFIG_PHY_TI

config SYS_LS_PFE_FW_ADDR
	hex "Flash address of PFE firmware"
	default 0x40240000

config DDR_PFE_PHYS_BASEADDR
	hex "PFE DDR physical base address"
	default 0x03800000

config DDR_PFE_BASEADDR
	hex "PFE DDR base address"
	default 0x83800000

config PFE_EMAC1_PHY_ADDR
	hex "PFE EMAC1 PHY ADDR"
	default 0x1

config PFE_EMAC2_PHY_ADDR
	hex "PFE EMAC2 PHY ADDR"
	default 0x2

endif
	
menu "Grapeboard configuration options"
	depends on TARGET_GRAPEBOARD

config CONCAT_PBL_UBOOT_IMAGE
	bool
	default y
	prompt "Concat PBL and U-boot.bin" 
	help 
		Enable concatenation of PBL binary 'PBL_BINARY_SRC' and 'u-boot.bin' with offset 'UBOOT_TEXT_OFFSET' into a single binary 'u-boot-with-pbl.bin'.
	
config UBOOT_TEXT_OFFSET
	string
	depends on CONCAT_PBL_UBOOT_IMAGE
	default 0x1000
	prompt "Concatenation offset for U-boot.bin to PBL binary"
	help
		See CONCAT_PBL_UBOOT_IMAGE help. Make sure this matches the offset used in the PBI command of the PBL binary and the SYS_TEXT_BASE define.
	
config PBL_BINARY_SRC
	string
	depends on CONCAT_PBL_UBOOT_IMAGE
	default "board/scalys/grapeboard/PBL_0x33_0x05_800_250_1000.bin"
	prompt "See CONCAT_PBL_UBOOT_IMAGE"
	help
		See CONCAT_PBL_UBOOT_IMAGE help.

config PBL_RCW_SECUREBOOT
	bool
	default n
	prompt "Enable Reset Control Word based secure boot for development"
	help
		To enable secure boot OTPMK and SRKH must be fused, u-boot-spl.bin must be signed, and the CSF header must be written to SPI flash.
		While using RCW secure boot a hash or signature failure while loading ESBC will not cause a boot halt, but SSM state will be non-secure.
		The Intent To Secure fuse should be blown for production platforms.
endmenu

source "board/freescale/common/Kconfig"

endif
```

## board/via/mx6vab820/Kconfig
```kconfig
if TARGET_MX6VAB820

config SYS_BOARD
	default "mx6vab820"

config SYS_VENDOR
	default "via"

config SYS_CONFIG_NAME
	default "mx6vab820"

endif
```

## configs/cl-som-imx7_nt_defconfig
```kconfig
CONFIG_ARM=y
CONFIG_ARCH_MX7=y
CONFIG_SYS_THUMB_BUILD=y
CONFIG_SYS_TEXT_BASE=0x87800000
CONFIG_TARGET_CL_SOM_IMX7=y
CONFIG_DEFAULT_DEVICE_TREE="imx7d-cl-som-imx7"
CONFIG_OF_CONTROL=y
CONFIG_FIT=y
CONFIG_FIT_VERBOSE=y
CONFIG_SPL_OPTEE_BOOT=y
CONFIG_SPL=y
CONFIG_SPL_LOAD_FIT=y
CONFIG_SPL_LEGACY_IMAGE_SUPPORT=n
CONFIG_SPL_FIT=y
CONFIG_SPL_OF_LIBFDT=y
CONFIG_SPL_BOARD_INIT=y
CONFIG_SPL_DM=y
CONFIG_SPL_CRYPTO_SUPPORT=y
CONFIG_SPL_ENABLE_CACHES=y
CONFIG_SPL_GPIO_SUPPORT=y
CONFIG_SPL_LIBCOMMON_SUPPORT=y
CONFIG_SPL_LIBGENERIC_SUPPORT=y
CONFIG_SPL_MMC_SUPPORT=y
CONFIG_SPL_SERIAL_SUPPORT=y
CONFIG_USE_TINY_PRINTF=y
CONFIG_SPL_USE_ARCH_MEMCPY=n
CONFIG_SPL_WATCHDOG_SUPPORT=y
CONFIG_ARMV7_BOOT_SEC_DEFAULT=y
CONFIG_ARMV7_NONSEC=n
CONFIG_BAUDRATE=115200
CONFIG_USE_BOOTCOMMAND=y
CONFIG_BOOTCOMMAND="fatload mmc 0:2 0x80A20000 /uefi.fit; bootm 0x80A20000"
CONFIG_BOOTDELAY=-2
CONFIG_IMX_PERSIST_INIT=y
CONFIG_EFI_LOADER=n
CONFIG_IMX_RDC=y
CONFIG_IMX_BOOTAUX=y
CONFIG_SYS_EXTRA_OPTIONS="IMX_CONFIG=arch/arm/mach-imx/spl_sd.cfg"
CONFIG_SECURE_BOOT=y
CONFIG_SPL_SYS_MALLOC_SIMPLE=y
CONFIG_SPI_BOOT=y
CONFIG_SYS_MMCSD_RAW_MODE_U_BOOT_USE_SECTOR=y
CONFIG_SYS_MMCSD_RAW_MODE_U_BOOT_SECTOR=0x8a
CONFIG_SPL_I2C_SUPPORT=y
CONFIG_SPL_SPI_LOAD=y
CONFIG_HUSH_PARSER=y
CONFIG_SYS_PROMPT="CL-SOM-iMX7 # "
CONFIG_CMD_BOOTZ=n
# CONFIG_CMD_IMI is not set
# CONFIG_CMD_XIMG is not set
# CONFIG_CMD_EXPORTENV is not set
# CONFIG_CMD_IMPORTENV is not set
CONFIG_CMD_GREPENV=y
CONFIG_CMD_GPIO=y
CONFIG_CMD_I2C=y
CONFIG_CMD_MMC=y
CONFIG_CMD_PART=y
CONFIG_CMD_SF=y
CONFIG_CMD_USB=y
CONFIG_CMD_DHCP=y
CONFIG_CMD_MII=y
CONFIG_CMD_PING=y
CONFIG_CMD_CACHE=y
CONFIG_CMD_EXT2=y
CONFIG_CMD_EXT4=y
CONFIG_CMD_EXT4_WRITE=y
CONFIG_CMD_FAT=y
CONFIG_CMD_FS_GENERIC=y
# CONFIG_ENV_IS_IN_MMC is not set
CONFIG_FSL_ESDHC=y
CONFIG_SPI_FLASH=y
CONFIG_SPI_FLASH_STMICRO=y
CONFIG_MII=y
CONFIG_SPI=y
CONFIG_MXC_SPI=y
CONFIG_USB=y
CONFIG_USB_EHCI_HCD=y
CONFIG_MXC_USB_OTG_HACTIVE=y
CONFIG_USB_STORAGE=y
CONFIG_USB_GADGET=y
CONFIG_CI_UDC=y
CONFIG_OF_LIBFDT=y
```

## configs/grapeboard_sata_qspi_rescue_flash_defconfig
```kconfig
CONFIG_ARM=y
CONFIG_TARGET_GRAPEBOARD=y
CONFIG_SYS_TEXT_BASE=0x40001000
CONFIG_FSL_LS_PPA=y
CONFIG_QSPI_AHB_INIT=y
CONFIG_AHCI=y
CONFIG_DEFAULT_DEVICE_TREE="grapeboard"
CONFIG_CONCAT_PBL_UBOOT_IMAGE=y
CONFIG_PBL_BINARY_SRC="board/scalys/grapeboard/PBL_0x33_0x08_800_250_1000_RESCUE_FLASH.bin"
CONFIG_NR_DRAM_BANKS=2
# CONFIG_SYS_MALLOC_F is not set
CONFIG_FIT_VERBOSE=y
CONFIG_OF_BOARD_SETUP=y
CONFIG_OF_STDOUT_VIA_ALIAS=y
CONFIG_SYS_EXTRA_OPTIONS="QSPI_BOOT"
CONFIG_QSPI_BOOT=y
CONFIG_BOOTDELAY=2
CONFIG_USE_BOOTARGS=y
CONFIG_BOOTARGS="console=ttyS0,115200 earlycon=uart8250,mmio,0x21c0500 quiet lpj=250000 noinitrd"
# CONFIG_DISPLAY_BOARDINFO is not set
CONFIG_HUSH_PARSER=y
CONFIG_CMD_GREPENV=y
CONFIG_CMD_GPT=y
CONFIG_CMD_MMC=y
CONFIG_CMD_SF=y
CONFIG_CMD_I2C=y
CONFIG_CMD_USB=y
# CONFIG_CMD_SETEXPR is not set
CONFIG_CMD_DHCP=y
CONFIG_CMD_MII=y
CONFIG_CMD_PING=y
CONFIG_CMD_CACHE=y
CONFIG_CMD_EXT2=y
CONFIG_CMD_FAT=y
CONFIG_OF_CONTROL=y
# CONFIG_ENV_IS_IN_SPI_FLASH is not set
CONFIG_ENV_IS_NOWHERE=y
CONFIG_NET_RANDOM_ETHADDR=y
CONFIG_DM=y
CONFIG_SATA_CEVA=y
CONFIG_DM_MMC=y
CONFIG_DM_SPI_FLASH=y
CONFIG_SPI_FLASH=y
# CONFIG_SPI_FLASH_USE_4K_SECTORS is not set
CONFIG_NETDEVICES=y
CONFIG_E1000=y
CONFIG_FSL_PFE=y
CONFIG_DM_ETH=y
CONFIG_PHYLIB=y
CONFIG_PHY_TI=y
CONFIG_PFE_EMAC1_PHY_ADDR=1
CONFIG_PFE_EMAC2_PHY_ADDR=2
CONFIG_PCI=y
CONFIG_DM_PCI=y
CONFIG_DM_PCI_COMPAT=y
CONFIG_PCIE_LAYERSCAPE=y
CONFIG_DM_SCSI=y
CONFIG_SYS_NS16550=y
CONFIG_SPI=y
CONFIG_DM_SPI=y
CONFIG_FSL_DSPI=y
CONFIG_USB=y
CONFIG_DM_USB=y
CONFIG_USB_XHCI_HCD=y
CONFIG_USB_XHCI_DWC3=y
CONFIG_USB_STORAGE=y
CONFIG_DISTRO_DEFAULTS=y
```

## configs/imx6ull_14x14_evk_nt_defconfig
```kconfig
CONFIG_ARM=y
CONFIG_ARCH_MX6=y
CONFIG_NR_DRAM_BANKS=1
CONFIG_SYS_TEXT_BASE=0x87800000
CONFIG_TARGET_IMX6ULL_14X14_EVK=y
CONFIG_DEFAULT_DEVICE_TREE="imx6ull-14x14-evk"
CONFIG_SUPPORT_RAW_INITRD=y
CONFIG_BOARD_EARLY_INIT_F=y
CONFIG_SYS_DCACHE_OFF=n
CONFIG_SYS_ICACHE_OFF=n
CONFIG_SYS_L2CACHE_OFF=y
CONFIG_BAUDRATE=921600
CONFIG_HUSH_PARSER=y
CONFIG_CMD_BOOTZ=y
CONFIG_CMD_BOOTM=y
CONFIG_CMD_MEMTEST=y
CONFIG_CMD_I2C=y
CONFIG_CMD_MMC=y
CONFIG_CMD_DHCP=y
CONFIG_CMD_PING=y
CONFIG_CMD_CACHE=y
CONFIG_CMD_FAT=y
CONFIG_CMD_PART=y
CONFIG_CMD_GLOBAL_PAGE=y
CONFIG_USE_BOOTCOMMAND=y
CONFIG_BOOTCOMMAND="globalpage init 0x80817000;  globalpage add ethaddr;fatload mmc 0:2 0x80020000 /uefi.fit; bootm 0x80020000"
CONFIG_BOOTDELAY=-2
CONFIG_IMX_PERSIST_INIT=y
CONFIG_EFI_LOADER=n
CONFIG_CMD_FS_GENERIC=y
CONFIG_OF_CONTROL=y
CONFIG_FIT=y
CONFIG_FIT_VERBOSE=y
CONFIG_SPL_OPTEE_BOOT=y
CONFIG_OF_LIBFDT=y
CONFIG_ENV_IS_IN_MMC=y
CONFIG_ENV_VARS_UBOOT_RUNTIME_CONFIG=y
CONFIG_DM_GPIO=y
CONFIG_DM_I2C=y
CONFIG_DM_MMC=y
CONFIG_FSL_ESDHC=y
CONFIG_PINCTRL=y
CONFIG_PINCTRL_IMX6=y
CONFIG_DM_REGULATOR=y
CONFIG_DM_SPI=y
CONFIG_USE_TINY_PRINTF=y
CONFIG_SECURE_BOOT=y
CONFIG_SPL=y
CONFIG_SPL_CRYPTO_SUPPORT=y
CONFIG_SPL_ENABLE_CACHES=y
CONFIG_SPL_MMC_SUPPORT=y
CONFIG_SPL_FIT=y
CONFIG_SPL_LOAD_FIT=y
CONFIG_SPL_OF_LIBFDT=y
CONFIG_SPL_SERIAL_SUPPORT=y
CONFIG_SPL_SYS_MALLOC_SIMPLE=y
CONFIG_SPL_GPIO_SUPPORT=y
CONFIG_SPL_LIBCOMMON_SUPPORT=y
CONFIG_SPL_LIBGENERIC_SUPPORT=y
CONFIG_SPL_WATCHDOG_SUPPORT=y
CONFIG_SPL_LDSCRIPT="arch/arm/cpu/u-boot-spl.lds"
CONFIG_SYS_EXTRA_OPTIONS="IMX_CONFIG=board/freescale/imx6ull_14x14_evk/imximage.cfg"
CONFIG_VIDEO=y
CONFIG_VIDEO_MXS=y
```

## configs/imx8mm_evk_nt_defconfig
```kconfig
CONFIG_ARM=y
CONFIG_ARCH_IMX8M=y
CONFIG_USE_BOOTCOMMAND=y
CONFIG_BOOTCOMMAND="globalpage init 0x407E9000; globalpage add ethaddr; usb start; part list mmc ${mmcdev} devplist; for bootpar in ${devplist}; do part type mmc ${mmcdev}:${bootpar} part_type; if test ${part_type} = 1d30adf8-0aef-4d83-b78c-ac719086c709; then if read mmc ${mmcdev}:${bootpar} 0x40800000 0 1000; then bootm 0x40800000; fi; fi; done;"
CONFIG_IMX_PERSIST_INIT=y
CONFIG_SYS_TEXT_BASE=0x40200000
CONFIG_SYS_MALLOC_F_LEN=0x2000
CONFIG_USB_TCPC=y
CONFIG_TARGET_IMX8MM_EVK=y
CONFIG_SYS_EXTRA_OPTIONS="IMX_CONFIG=arch/arm/mach-imx/spl_sd.cfg,SPL_TEXT_BASE=0x7E1000,FB_ADDR=CONFIG_SYS_SDRAM_BASE"
CONFIG_FIT=y
CONFIG_SPL_LOAD_FIT=y
CONFIG_ARCH_MISC_INIT=y
CONFIG_SPL=y
CONFIG_SPL_BOARD_INIT=y
CONFIG_SPL_MMC_SUPPORT=y
CONFIG_HUSH_PARSER=y
CONFIG_OF_LIBFDT=y
CONFIG_FS_FAT=y
CONFIG_CMD_FAT=y
CONFIG_DEFAULT_DEVICE_TREE="fsl-imx8mm-evk"
CONFIG_DEFAULT_FDT_FILE="fsl-imx8mm-evk.dtb"
CONFIG_CMD_SF=y
CONFIG_CMD_I2C=y
CONFIG_CMD_GPIO=y
CONFIG_CMD_CACHE=y
CONFIG_CMD_REGULATOR=y
CONFIG_CMD_MEMTEST=y
CONFIG_OF_CONTROL=y

CONFIG_DM_GPIO=y
CONFIG_DM_I2C=y
CONFIG_SYS_I2C_MXC=y
CONFIG_DM_MMC=y
# CONFIG_DM_PMIC=y
CONFIG_EFI_PARTITION=y
CONFIG_DM_SPI_FLASH=y
CONFIG_SPI_FLASH=y
CONFIG_SPI_FLASH_STMICRO=y
CONFIG_DM_ETH=y
CONFIG_PINCTRL=y
CONFIG_PINCTRL_IMX8M=y
CONFIG_DM_REGULATOR=y
CONFIG_DM_REGULATOR_FIXED=y
CONFIG_DM_REGULATOR_GPIO=y
CONFIG_DM_SPI=y
CONFIG_FSL_FSPI=y
CONFIG_NXP_TMU=y
CONFIG_DM_THERMAL=y
CONFIG_USB=y
CONFIG_USB_GADGET=y
CONFIG_USB_GADGET_DOWNLOAD=y
CONFIG_DM_USB=y
CONFIG_USB_EHCI_HCD=y

CONFIG_BOOTDELAY=-2
CONFIG_CMD_GPT=y
CONFIG_CMD_GLOBAL_PAGE=y
CONFIG_PARTITION_TYPE_GUID=y
CONFIG_CMD_PART=y

CONFIG_SPL_USB_HOST_SUPPORT=y
CONFIG_SPL_USB_GADGET_SUPPORT=y
CONFIG_USB_GADGET_MANUFACTURER="FSL"
CONFIG_USB_GADGET_VENDOR_NUM=0x0525
CONFIG_USB_GADGET_PRODUCT_NUM=0xa4a5

CONFIG_VIDEO=y
CONFIG_IMX_SEC_MIPI_DSI=y
```

## configs/imx8mq_evk_nt_defconfig
```kconfig
CONFIG_ARM=y
CONFIG_ARCH_IMX8M=y
CONFIG_BAUDRATE=921600
CONFIG_USE_BOOTCOMMAND=y
CONFIG_BOOTCOMMAND="globalpage init 0x407E9000; globalpage add ethaddr; usb start; part list mmc ${mmcdev} devplist; for bootpar in ${devplist}; do part type mmc ${mmcdev}:${bootpar} part_type; if test ${part_type} = 1d30adf8-0aef-4d83-b78c-ac719086c709; then if read mmc ${mmcdev}:${bootpar} 0x40800000 0 1000; then bootm 0x40800000; fi; fi; done;"
CONFIG_IMX_PERSIST_INIT=y
CONFIG_SYS_TEXT_BASE=0x40200000
CONFIG_SYS_MALLOC_F_LEN=0x2000
CONFIG_TARGET_IMX8MQ_EVK=y
CONFIG_SAVED_DRAM_TIMING_BASE=0x40000000
CONFIG_SYS_EXTRA_OPTIONS="IMX_CONFIG=arch/arm/mach-imx/spl_sd.cfg,FB_ADDR=CONFIG_SYS_SDRAM_BASE"
CONFIG_ARCH_MISC_INIT=y
CONFIG_SPL=y
CONFIG_SPL_BOARD_INIT=y
CONFIG_HUSH_PARSER=y
CONFIG_OF_LIBFDT=y
CONFIG_FS_FAT=y
CONFIG_CMD_FAT=y
CONFIG_CMD_MEMTEST=y
CONFIG_CMD_CACHE=y
CONFIG_DEFAULT_DEVICE_TREE="fsl-imx8mq-evk"
CONFIG_OF_CONTROL=y
CONFIG_PINCTRL=y
CONFIG_PINCTRL_IMX8M=y
CONFIG_SYS_I2C_MXC=y
CONFIG_CMD_I2C=y
CONFIG_DM_I2C=y
CONFIG_DM_GPIO=y
CONFIG_CMD_GPIO=y
CONFIG_DM_MMC=y
CONFIG_CMD_REGULATOR=y
CONFIG_CMD_PART=y
CONFIG_DM_PMIC=y
CONFIG_DM_PMIC_PFUZE100=y
CONFIG_DM_REGULATOR=y
CONFIG_DM_REGULATOR_PFUZE100=y
CONFIG_DM_REGULATOR_FIXED=y
CONFIG_DM_REGULATOR_GPIO=y
CONFIG_DM_ETH=y
CONFIG_CMD_PMIC=y
CONFIG_NXP_TMU=y
CONFIG_DM_THERMAL=y
CONFIG_FIT=y
CONFIG_SPL_FIT=y
CONFIG_SPL_LOAD_FIT=y
CONFIG_USB_TCPC=y
CONFIG_USB=y
CONFIG_DM_USB=y
CONFIG_VIDEO=y
CONFIG_VIDEO_IMX8_HDMI=y
CONFIG_BOOTDELAY=-2
CONFIG_CMD_GPT=y
CONFIG_CMD_GLOBAL_PAGE=y
CONFIG_EFI_PARTITION=y
CONFIG_PARTITION_TYPE_GUID=y
CONFIG_USB_GADGET=y
CONFIG_USB_GADGET_VENDOR_NUM=0x0525
CONFIG_USB_GADGET_PRODUCT_NUM=0xa4a5
CONFIG_USB_GADGET_MANUFACTURER="FSL"
CONFIG_USB_GADGET_DOWNLOAD=y
CONFIG_SPL_USB_HOST_SUPPORT=y
CONFIG_SPL_USB_GADGET_SUPPORT=y
CONFIG_USB_XHCI_HCD=y
CONFIG_USB_XHCI_IMX8M=y
CONFIG_USB_XHCI_DWC3=y
CONFIG_USB_DWC3=y
CONFIG_USB_DWC3_GADGET=y
```

## configs/ls1088ardb_qspi_SECURE_BOOT_defconfig
```kconfig
CONFIG_ARM=y
# CONFIG_CMD_SETEXPR is not set
CONFIG_CMD_DHCP=y
CONFIG_CMD_I2C=y
CONFIG_CMD_MMC=y
CONFIG_CMD_PING=y
CONFIG_CMD_SF=y
CONFIG_CMD_USB=y
# CONFIG_SYS_MALLOC_F is not set
CONFIG_DEFAULT_DEVICE_TREE="fsl-ls1088a-rdb"
CONFIG_USE_BOOTARGS=y
CONFIG_BOOTARGS="console=ttyS0,115200 root=/dev/ram0 earlycon=uart8250,mmio,0x21c0500 ramdisk_size=0x3000000 default_hugepagesz=2m hugepagesz=2m hugepages=256"
CONFIG_CMD_GREPENV=y
CONFIG_DISTRO_DEFAULTS=y
CONFIG_DM=y
CONFIG_DM_PCI=y
CONFIG_DM_PCI_COMPAT=y
CONFIG_DM_SPI=y
CONFIG_DM_SPI_FLASH=y
CONFIG_DM_USB=y
CONFIG_EFI_LOADER_BOUNCE_BUFFER=y
CONFIG_ENV_IS_IN_SPI_FLASH=y
CONFIG_E1000=y
CONFIG_FIT_VERBOSE=y
CONFIG_FSL_CAAM=y
CONFIG_FSL_DSPI=y
CONFIG_FSL_LS_PPA=y
CONFIG_HUSH_PARSER=y
CONFIG_NETDEVICES=y
CONFIG_NET_RANDOM_ETHADDR=y
CONFIG_OF_BOARD_SETUP=y
CONFIG_OF_CONTROL=y
CONFIG_OF_STDOUT_VIA_ALIAS=y
CONFIG_PCI=y
CONFIG_PCIE_LAYERSCAPE=y
CONFIG_RSA=y
CONFIG_RSA_SOFTWARE_EXP=y
CONFIG_SECURE_BOOT=y
CONFIG_SPI_FLASH=y
CONFIG_SPI_FLASH_SPANSION=y
CONFIG_SYS_EXTRA_OPTIONS="SYS_FSL_DDR4, QSPI_BOOT"
CONFIG_SYS_NS16550=y
CONFIG_TARGET_LS1088ARDB=y
CONFIG_USB=y
CONFIG_USB_DWC3=y
CONFIG_USB_GADGET=y
CONFIG_USB_STORAGE=y
CONFIG_USB_XHCI_DWC3=y
CONFIG_USB_XHCI_HCD=y
# CONFIG_DISPLAY_BOARDINFO is not set
# CONFIG_USE_BOOTCOMMAND is not set
```
